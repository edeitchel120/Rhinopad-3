/ {
    chosen {
        zmk,display = &rhinopad_oled;
        zephyr,display = &rhinopad_oled;
    };
};

/*
 * I2C controller + SSD1306 128x32 OLED at 0x3C
 * NOTE: Adjust sda-pin / scl-pin if your PCB uses different pins.
 */
&i2c0 {
    status = "okay";

    /* Use nrf-twi binding (no pinctrl-0 required) */
    compatible = "nordic,nrf-twi";

    /* Example wiring: SDA = P0.24, SCL = P0.25 */
    sda-pin = <24>;
    scl-pin = <25>;

    /* 100 kHz I2C */
    clock-frequency = <I2C_BITRATE_STANDARD>;

    rhinopad_oled: oled@3c {
        compatible = "solomon,ssd1306fb";
        reg = <0x3c>;
        label = "Rhinopad_OLED";

        width = <128>;
        height = <32>;

        /* Required geometry/orientation properties */
        segment-offset = <0>;
        page-offset = <0>;
        display-offset = <0>;
        multiplex-ratio = <31>;

        segment-remap;
        com-seq;
        com-invdir;

        /* Required by solomon,ssd1306fb-i2c binding */
        prechargep = <2>;

        /* Uncomment and adjust if your OLED uses a reset pin:
         * reset-gpios = <&gpio0 15 GPIO_ACTIVE_LOW>;
         */
    };
};
